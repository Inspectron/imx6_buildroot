## .power_new/supply/axp/Kconfig
```kconfig
#menuconfig POWER_SUPPLY
#	bool "Power supply class support"
#	help
#	  Say Y here to enable power supply class support. This allows
#	  power supply (batteries, AC, USB) monitoring by userspace
#	  via sysfs and uevent (if available) and/or APM kernel interface
#	  (if selected below).
#
#if POWER_SUPPLY

menuconfig AW_AXP
	bool "AXP Power drivers"
	depends on REGULATOR
	#depends on ARCH_SUNXI
	select MFD_CORE
	help
	  This option allows you to select AXP power driver

if AW_AXP

config AXP_TWI_USED
	bool "AXP use twi as transfer channel"
	depends on I2C
	help
	  To use twi as transfer channel

config AXP_ARISC_TWI_USED
	bool "AXP use arisc twi as transfer channel"
	help
	  To use arisc twi as transfer channel

config DUAL_AXP_USED
	bool "Support dual axp online"
	depends on ARCH_SUN8IW10 || ARCH_SUN8IW15

config AW_AXP2585
	bool "AXP2585 driver"
	#depends on ARCH_SUN8IW15
	help
	AXP2585 driver, AXP2585 is a BMU,which is just for battery power manager.
	We could use a BMU and a PMU for high voltage project.The BMU is good
	at manage battery, and the PMU could be a supplier of  periphrals.
	Say Y here to enable AXP2585 driver.


endif # AW_AXP

#endif # POWER_SUPPLY
```
